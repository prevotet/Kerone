/*******************************************************************/
/*                                                                 */
/* This file is automatically generated by linker script generator.*/
/*                                                                 */
/* Version: Xilinx EDK 14.7 EDK_P.20131013                                */
/*                                                                 */
/* Copyright (c) 2010 Xilinx, Inc.  All rights reserved.           */
/*                                                                 */
/* Description : Cortex-A9 Linker Script                          */
/*                                                                 */
/*******************************************************************/
/*INCLUDE C:\Xilinx\XIATAN\Xilinx\proj\tutoral\myproj\trial04\nova\src\include\memory.h;*/

LOAD_ADDR = 0x200000;
LINK_ADDR = 0xC0000000;

_STACK_SIZE = DEFINED(_STACK_SIZE) ? _STACK_SIZE : 0x400;
_HEAP_SIZE = DEFINED(_HEAP_SIZE) ? _HEAP_SIZE : 0x400;

_ABORT_STACK_SIZE = DEFINED(_ABORT_STACK_SIZE) ? _ABORT_STACK_SIZE : 1024;
_SUPERVISOR_STACK_SIZE = DEFINED(_SUPERVISOR_STACK_SIZE) ? _SUPERVISOR_STACK_SIZE : 2048;
_FIQ_STACK_SIZE = DEFINED(_FIQ_STACK_SIZE) ? _FIQ_STACK_SIZE : 1024;
_UNDEF_STACK_SIZE = DEFINED(_UNDEF_STACK_SIZE) ? _UNDEF_STACK_SIZE : 1024;



/* added by JC because required by vivado 2015.4 for xil_cache.c */
/*_IRQ_STACK_SIZE = DEFINED(_IRQ_STACK_SIZE) ? _IRQ_STACK_SIZE : 1024;*/
/* end added by JC */

/* Define Memories in the system */

MEMORY
{
   ps7_ddr_0_S_AXI_BASEADDR : ORIGIN = 0x00100000, LENGTH = 0x1FF00000
   ps7_ram_0_S_AXI_BASEADDR : ORIGIN = 0x00000000, LENGTH = 0x00030000
   ps7_ram_1_S_AXI_BASEADDR : ORIGIN = 0xFFFF0000, LENGTH = 0x0000FE00
}


PHDRS
{
    init    PT_LOAD;
    kern    PT_LOAD;
}

/* Specify the default entry point to the program */

ENTRY(_start)

/* Define the sections, and where they are mapped in memory */

SECTIONS
{
.init 0x200000 :
AT(0x200000) 
{
   KEEP (*(.init))
   KEEP (*(.initdata))
} :init

. = ALIGN(4K) + 4K; 

PROVIDE (INIT_STCK = .);
 _stack_end = .;
 __undef_stack = .;
 
PROVIDE (LOAD_E = .);

OFFSET = LINK_ADDR - ALIGN (4M);

/*OFFSET = 0x1000;*/

PROVIDE (LINK_P = LINK_ADDR - OFFSET);

.text 0xc0000000 : 
AT(ADDR (.text) - OFFSET)
{
   *(.vectors)
   *(.boot)
   *(.text)
   *(.text.*)
   *(.gnu.linkonce.t.*)
   *(.plt)
   *(.gnu_warning)
   *(.gcc_execpt_table)
   *(.glue_7)
   *(.glue_7t)
   *(.vfp11_veneer)
   *(.ARM.extab)   
   *(.gnu.linkonce.armextab.*)
} :kern

.fini . :  AT(ADDR (.fini) - OFFSET)
{
   KEEP (*(.fini))
} :kern

.rodata . : 
AT(ADDR (.rodata) - OFFSET)
{
   __rodata_start = .;
   *(.rodata)
   *(.rodata.*)
   *(.gnu.linkonce.r.*)
   __rodata_end = .;
} :kern

.rodata1 . : 
AT(ADDR (.rodata1) - OFFSET)
{
   __rodata1_start = .;
   *(.rodata1)
   *(.rodata1.*)
   __rodata1_end = .;
} :kern

.sdata2 . : 
AT(ADDR (.sdata2) - OFFSET)
{
   __sdata2_start = .;
   *(.sdata2)
   *(.sdata2.*)
   *(.gnu.linkonce.s2.*)
   __sdata2_end = .;
} :kern

.sbss2 . : 
AT(ADDR (.sbss2) - OFFSET)
{
   __sbss2_start = .;
   *(.sbss2)
   *(.sbss2.*)
   *(.gnu.linkonce.sb2.*)
   __sbss2_end = .;
} :kern

.data . : 
AT(ADDR (.data) - OFFSET)
{
   __data_start = .;
   *(.data)
   *(.data.*)
   *(.gnu.linkonce.d.*)
   *(.jcr)
   *(.got)
   *(.got.plt)
   __data_end = .;
} :kern

.data1 . : 
AT(ADDR (.data1) - OFFSET)
{
   __data1_start = .;
   *(.data1)
   *(.data1.*)
   __data1_end = .;
} :kern

.got . : 
AT(ADDR (.got) - OFFSET)
{
   *(.got)
} :kern

.ctors . : 
AT(ADDR (.ctors) - OFFSET)
{
   __CTOR_LIST__ = .;
   ___CTORS_LIST___ = .;
   PROVIDE( CTROS_L = .);
   KEEP (*crtbegin.o(.ctors))
   KEEP (*(EXCLUDE_FILE(*crtend.o) .ctors))
   KEEP (*(SORT(.ctors.*)))
   KEEP (*(.ctors))
   PROVIDE( CTROS_E = .);
   __CTOR_END__ = .;
   ___CTORS_END___ = .;
} :kern

.dtors . : 
AT(ADDR (.dtors) - OFFSET)
{
   __DTOR_LIST__ = .;
   ___DTORS_LIST___ = .;
   KEEP (*crtbegin.o(.dtors))
   KEEP (*(EXCLUDE_FILE(*crtend.o) .dtors))
   KEEP (*(SORT(.dtors.*)))
   KEEP (*(.dtors))
   __DTOR_END__ = .;
   ___DTORS_END___ = .;
} :kern

.fixup . : 
AT(ADDR (.fixup) - OFFSET)
{
   __fixup_start = .;
   *(.fixup)
   __fixup_end = .;
} :kern

.eh_frame . : 
AT(ADDR (.eh_frame) - OFFSET)
{
   *(.eh_frame)
} :kern

.eh_framehdr . : 
AT(ADDR (.eh_framehdr) - OFFSET)
{
   __eh_framehdr_start = .;
   *(.eh_framehdr)
   __eh_framehdr_end = .;
} :kern

.ARM.exidx . : 
AT(ADDR (.ARM.exidx) - OFFSET)
{
   __exidx_start = .;
   *(.ARM.exidx*)
   *(.gnu.linkonce.armexidix.*.*)
   __exidx_end = .;
} :kern

.init_array . : 
AT(ADDR (.init_array) - OFFSET)
{
   __init_array_start = .;
   PROVIDE(init_array_start = .);
   KEEP (*(SORT(.init_array.*)))
   KEEP (*(.init_array))
   PROVIDE(init_array_end = .);
   __init_array_end = .;
}  :kern

.fini_array . : 
AT(ADDR (.fini_array) - OFFSET)
{
   __fini_array_start = .;
   KEEP (*(SORT(.fini_array.*)))
   KEEP (*(.fini_array))
   __fini_array_end = .;
} :kern

.ARM.attributes . : 
AT(ADDR (.ARM.attributes) - OFFSET)
{
   __ARM.attributes_start = .;
   *(.ARM.attributes)
   __ARM.attributes_end = .;
} :kern


.bss . : 
AT(ADDR (.bss) - OFFSET)
{
   __bss_start = .;
   *(.bss)
   *(.bss.*)
   *(.gnu.linkonce.b.*)
   *(COMMON)
      
   . = ALIGN(16K);
   PROVIDE (KERN_PDIR  = . - OFFSET); 
   . += 16K;
   _mempool_f = .;
   . += 16M;
   . = ALIGN(4M);
   PROVIDE (LINK_E = . - OFFSET);
   PROVIDE (_mempool_e = .);
	
   __bss_end = .;
} :kern

/DISCARD/ :
{
   *(.note.GNU-stack)
   *(.comment*)
}
/* added by JC for vivado 2015.4 **/
/*.heap (NOLOAD) : {
   . = ALIGN(16);
   _heap = .;
   HeapBase = .;
   _heap_start = .;
   . += _HEAP_SIZE;
   _heap_end = .;
   HeapLimit = .;
} > ps7_ddr_0_S_AXI_BASEADDR*/

/*.stack (NOLOAD) : {
   . = ALIGN(16);
   _stack_end = .;
   . += _STACK_SIZE;
   . = ALIGN(16);
   _stack = .;
   __stack = _stack;
   . = ALIGN(16);
   _irq_stack_end = .;
   . += _IRQ_STACK_SIZE;
   . = ALIGN(16);
   __irq_stack = .;
   _supervisor_stack_end = .;
   . += _SUPERVISOR_STACK_SIZE;
   . = ALIGN(16);
   __supervisor_stack = .;
   _abort_stack_end = .;
   . += _ABORT_STACK_SIZE;
   . = ALIGN(16);
   __abort_stack = .;
   _fiq_stack_end = .;
   . += _FIQ_STACK_SIZE;
   . = ALIGN(16);
   __fiq_stack = .;
   _undef_stack_end = .;
   . += _UNDEF_STACK_SIZE;
   . = ALIGN(16);
   __undef_stack = .;
} > ps7_ddr_0_S_AXI_BASEADDR*/
/* end added by JC for vivado 2015.4 **/
}

