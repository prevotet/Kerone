/*******************************************************************/
/*                                                                 */
/* This file is automatically generated by linker script generator.*/
/*                                                                 */
/* Version: Xilinx EDK 14.7 EDK_P.20131013                         */
/*                                                                 */
/* Copyright (c) 2010 Xilinx, Inc.  All rights reserved.           */
/*                                                                 */
/* Description : Cortex-A9 Linker Script                          */
/*                                                                 */
/*******************************************************************/

/* Define Memories in the system */

_HEAP_SIZE = DEFINED(_HEAP_SIZE) ? _HEAP_SIZE : 0x400;

MEMORY
{
   ps7_ddr_0_S_AXI_BASEADDR : ORIGIN = 0x00100000, LENGTH = 0x3FF00000
   ps7_ram_0_S_AXI_BASEADDR : ORIGIN = 0x00000000, LENGTH = 0x00030000
   ps7_ram_1_S_AXI_BASEADDR : ORIGIN = 0xFFFF0000, LENGTH = 0x0000FE00
}

/* Specify the default entry point to the program */


PHDRS
{
	data    PT_LOAD FLAGS(6);
	text    PT_LOAD FLAGS(5);
}

ENTRY(_start)

/* Define the sections, and where they are mapped in memory */

SECTIONS
{
. = SIZEOF_HEADERS;

.data . : 
AT( ADDR(.data) )
{
   __data_start = .;
   *(.data)
   *(.data.*)
   *(.gnu.linkonce.d.*)
   *(.jcr)
   *(.got)
   *(.got.plt)
   __data_end = .;
} : data

.rodata . : 
AT( ADDR(.rodata) )
{
   __rodata_start = .;
   *(.rodata)
   *(.rodata.*)
   *(.gnu.linkonce.r.*)
   __rodata_end = .;
} : data

.eh_frame . : 
AT( ADDR(.eh_frame) )
{
   *(.eh_frame)
} : data

.eh_framehdr . : 
AT( ADDR(.eh_framehdr) )
{
   __eh_framehdr_start = .;
   *(.eh_framehdr)
   __eh_framehdr_end = .;
} : data

.ARM.exidx . : 
AT(ADDR (.ARM.exidx) )
{
   __exidx_start = .;
   *(.ARM.exidx*)
   *(.gnu.linkonce.armexidix.*.*)
   __exidx_end = .;
} : data

.ARM.extab . : 
AT(ADDR (.ARM.extab) )
{
   __extab_start = .;
   *(.ARM.extab*)
   __extab_end = .;
} : data

.init_array . : 
AT( ADDR(.init_array) )
{
   __init_array_start = .;
   *(SORT(.init_array.*))
   *(.init_array)
   __init_array_end = .;
} : data

.fini_array . : 
AT( ADDR(.fini_array) )
{
   __fini_array_start = .;
   *(SORT(.fini_array.*))
   *(.fini_array)
   __fini_array_end = .;
} : data

.ARM.attributes . : 
AT( ADDR(.ARM.attributes) )
{
   __ARM.attributes_start = .;
   *(.ARM.attributes)
   __ARM.attributes_end = .;
} : data

.bss . :
AT( ADDR(.bss) )
{
   __bss_start = .;
   *(.bss)
   *(.bss.*)
   *(.gnu.linkonce.b.*)
   *(COMMON)
   __bss_end = .;
   
   . = ALIGN(0x1000);
   
} :data

.stack . :
AT( ADDR(.stack) ) 
{
	BYTE(42);
    . = ALIGN(0x1000);
    PROVIDE ( stack_top = . );
} : data

.text . : 
AT( ADDR(.text) )
{
   *(.vectors)	
   *(.boot)
   *(.text)
   *(.text.*)
   *(.gnu.linkonce.t.*)
   *(.plt)
   *(.gnu_warning)
   *(.gcc_execpt_table)
   *(.glue_7)
   *(.glue_7t)
   *(.vfp11_veneer)
   *(.ARM.extab)
   *(.gnu.linkonce.armextab.*)
} : text

.init . : 
AT( ADDR(.init) )
{
   *(.init)
} : text

.fini . : 
AT( ADDR(.fini) )
{
   *(.fini)
} : text

/*.heap (NOLOAD) : {
   . = ALIGN(16);
   _heap = .;
   HeapBase = .;
   _heap_start = .;
   . += _HEAP_SIZE;
   _heap_end = .;
   HeapLimit = .;
} > ps7_ddr_0_S_AXI_BASEADDR*/

_end = .;

}

